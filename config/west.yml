## config/west.yml
```yaml
manifest:
  remotes:
    - name: zmkfirmware
      url-base: https://github.com/zmkfirmware
    - name: carrefinho
      url-base: https://github.com/carrefinho
    - name: caksoylar
      url-base: https://github.com/caksoylar
    - name: sadekbaroudi
      url-base: https://github.com/sadekbaroudi
    - name: duckyb
      url-base: https://github.com/duckyb
      # nice-view-gem
    - name: anywhy-io
      url-base: https://github.com/anywhy-io
    - name: m165437
      url-base: https://github.com/M165437
  projects:
    - name: zmk
      remote: zmkfirmware
      revision: main
      import: app/west.yml
    - name: prospector-zmk-module
      remote: carrefinho
      revision: main
    - name: zmk-fingerpunch-keyboards
      remote: sadekbaroudi
      revision: main
      import: config/deps.yml
    - name: urchin-zmk-module
      remote: duckyb
      revision: main
    - name: flake-zmk-module
      remote: anywhy-io
  self:
    path: config
```
